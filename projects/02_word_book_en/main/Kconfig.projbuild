## projects/02_word_book_en/main/Kconfig.projbuild
```kconfig
menu "Word book"

    config WORDBOOK_BOOT_SELFTEST
        bool "Run the recogniser self-test at boot"
        default y
        help
            Feeds three embedded synthesised clips through the recogniser after
            start-up and shows each result with its card and chime. Proves the
            engine over serial with nobody present. Turn off for the toy build;
            it costs about 15 seconds and three chimes on every boot.

    config WORDBOOK_MIN_PROB_PCT
        int "Minimum confidence to show a card (%)"
        range 1 99
        default 30
        help
            Detections below this are ignored. Digital silence produces a fixed
            junk detection at 13.5%; a lived-in room with 19 words produced 90
            accepted noise detections in 45 minutes at a 20% floor, median 25%.
            Adult speech at arm's length scored 16-53% across ten words. Tune on
            the child, from the classifier records on the card.

    config WORDBOOK_VAD_ENERGY_DBFS
        int "VAD energy floor (dBFS, negative)"
        range -100 -10
        default -48
        help
            Frames quieter than this are never speech, whatever the VAD model
            thinks. A lived-in room measured -52 dBFS average; a voice at arm's
            length is well above -48. Only applies with the vadnet model.

    config WORDBOOK_MIC_GAIN_DB
        int "Microphone gain (dB)"
        range 0 42
        default 30
        help
            ES8311 input PGA gain. At 30 dB an adult at arm's length peaks around
            -12 dBFS with the room at -52 dBFS (2026-09-06). A soft-spoken child may
            need 33-36; clipping shows as peaks at 0 dBFS in the "mic:" lines.

    config WORDBOOK_SOUND_PROB_PCT
        int "Minimum confidence for the chime and prompt (%)"
        range 1 99
        default 45
        help
            Between MIN_PROB and this, the card is shown silently. At or above
            it, the chime and the recorded prompt play too. A wrong card is
            cheap; a wrong sound is what makes a toy feel broken. 35% let 13
            noise chimes through in 45 minutes.

    config WORDBOOK_SOUND
        bool "Play the chime and prompts"
        default y
        help
            Off: cards still show, nothing is ever played - self-test included.
            Kept off in sdkconfig.defaults while the false-positive rate is being
            tuned from the classifier records.

    config WORDBOOK_VOLUME
        int "Speaker volume (0-100)"
        range 0 100
        default 90
        help
            The vendor example uses 90 on V2 hardware and 70 on V1.

    config WORDBOOK_BRIGHTNESS
        int "Display brightness when active (0-100)"
        range 1 100
        default 85

    config WORDBOOK_DIM_BRIGHTNESS
        int "Display brightness when idle (0-100)"
        range 0 100
        default 50
        help
            12 and 35 both read as "screen off" on this AMOLED with a dark card.

    config WORDBOOK_SLEEP_AFTER_S
        int "Minutes of quiet before the screen turns off and listening stops, 0 to never"
        range 0 1440
        default 0
        help
            After this long with no word, the display goes fully off and the
            recogniser is stopped. Press BOOT to wake. BOOT never sleeps it;
            the serial `s` command and a thermal trip do.

            Default 0: the board never turns its own screen off. Every "black
            screen" report on this project so far has been the board darkening
            itself while someone was looking at it, and a dark screen is
            indistinguishable from a dead one. Set a timeout only once the
            panel has been proven to survive a sleep/wake cycle unattended.

    config WORDBOOK_LONG_PRESS_MS
        int "BOOT hold time for maintenance mode (ms)"
        range 300 5000
        default 1000
        help
            A shorter hold is a short press: wake the screen, or acknowledge on
            the status line. 2026-09-06: holds of 1.25 s meant as long fell
            under the old 1.5 s threshold.

    config WORDBOOK_SLEEP_POWER_LOG_S
        int "Seconds between state records while asleep"
        range 30 3600
        default 300
        help
            Awake, a record is written every WORDBOOK_POWER_LOG_S seconds. Asleep
            the cadence drops to this: enough for the battery curve overnight.

    config WORDBOOK_TZ
        string "Time zone (POSIX TZ string)"
        default "AEST-10AEDT,M10.1.0,M4.1.0/3"
        help
            Used for timestamps in the log file. Default is Sydney.

    config WORDBOOK_NTP
        bool "Sync the clock from NTP over Wi-Fi at boot when a network is configured"
        default y
        help
            Joins WORDBOOK_WIFI_SSID as a station, fetches the time, writes it to
            the RTC, then turns Wi-Fi off. Skipped silently when the SSID is empty.
            Put the real SSID and password in sdkconfig.defaults.local, never here.

    config WORDBOOK_WIFI_SSID
        string "Home Wi-Fi network for NTP"
        depends on WORDBOOK_NTP
        default ""

    config WORDBOOK_WIFI_PASSWORD
        string "Home Wi-Fi password"
        depends on WORDBOOK_NTP
        default ""

    config WORDBOOK_NTP_SERVER
        string "NTP server"
        depends on WORDBOOK_NTP
        default "pool.ntp.org"

    config WORDBOOK_NTP_TIMEOUT_S
        int "Seconds to wait for Wi-Fi before giving up"
        depends on WORDBOOK_NTP
        range 3 60
        default 15

    config WORDBOOK_LOG_MAX_KB
        int "Log file cap (KB) before rotation to .1"
        range 64 65536
        default 4096

    config WORDBOOK_PROBE_HOST
        string "Host the board pings when maintenance mode starts (diagnostic)"
        default ""
        help
            Set to the laptop's address to see from the board's side whether the
            two can reach each other. Empty disables it. The gateway is always pinged.

    config WORDBOOK_POWER_LOG_S
        int "Seconds between power records"
        range 5 3600
        default 30

    config WORDBOOK_MAINT_IDLE_MIN
        int "Minutes without a request before maintenance mode ends"
        range 1 120
        default 10

    config WORDBOOK_DIM_AFTER_S
        int "Seconds of quiet before dimming, 0 to never"
        range 0 3600
        default 0
        help
            Default 0: no idle dimming. The thermal guard still dims a warm
            board - that one has a reason the user can be told about.

    config WORDBOOK_THERMAL_WARM_C
        int "Thermal guard: warm, die C (screen dims)"
        range 30 120
        default 60
        help
            The hotter of the chip die and the PMU die, read once a second. At warm the
            screen is held at the dim level and the status line says so. Die
            temperatures run well above the case; calibrate against a thermometer on
            the glass before trusting the defaults for a child's hands.

    config WORDBOOK_THERMAL_HOT_C
        int "Thermal guard: hot, die C (sleep, charger off, BOOT ignored)"
        range 30 125
        default 70

    config WORDBOOK_THERMAL_TRIP_C
        int "Thermal guard: trip, die C (PMU powers the board off)"
        range 30 130
        default 80
        help
            The board writes a marker to NVS, records the trip on the card, waits
            three seconds for the card, and powers itself off through the PMU. It comes
            back on PWR or a USB insert, and the boot record names the trip.

    config WORDBOOK_THERMAL_HYST_C
        int "Thermal guard: degrees below a line before the level drops"
        range 1 20
        default 5

    config WORDBOOK_THERMAL_SAMPLES
        int "Thermal guard: consecutive seconds that must agree before the level changes"
        range 1 60
        default 5

    config WORDBOOK_PMU_TREG_C
        int "PMU charger thermal regulation, die C (60, 80, 100 or 120)"
        range 60 120
        default 60
        help
            The AXP2101 lowers its own charge current once its die passes this line,
            whether or not the firmware is running. Chip default 100. Values between
            the four steps round down.

endmenu
```

## projects/05_dictation/main/Kconfig.projbuild
```kconfig
menu "Dictation"

    choice DICT_LANG
        prompt "Recognition language"
        default DICT_LANG_EN
        help
            Picks the app-side behaviour: probe vocabulary, font, and dictionary path.
            It does NOT pick the MultiNet model - that is esp-sr's own Kconfig, set by
            sdkconfig.en / sdkconfig.cn. Keep the two in step; app_main checks at boot
            and refuses to start if they disagree.

    config DICT_LANG_EN
        bool "English (mn7_en)"

    config DICT_LANG_CN
        bool "Chinese (mn7_cn)"

    endchoice

    config DICT_PROBE_ON_BOOT
        bool "Run the MX experiments at boot and log the results"
        default y
        help
            MX-1 logs raw_string on every MultiNet result, detected AND timed out.
            MX-2 loads a syllable table instead of words. Both exist to answer whether
            this project is possible at all - see docs/design/05_dictation.md. Leave on
            until the go/no-go is settled.

    config DICT_PROBE_SYLLABLES
        bool "MX-2: load syllables instead of words"
        depends on DICT_PROBE_ON_BOOT
        default n
        help
            Loads the syllable table rather than the small word list, so continuous
            speech has a chance of firing syllable after syllable. Off by default so
            MX-1 is measured against a known-good vocabulary first.

    config DICT_SYLLABLE_LIMIT
        int "Cap the syllable table at this many entries, 0 for all"
        range 0 300
        default 0
        help
            Diagnostic. 212 Mandarin syllables crash esp-sr's FST builder while 187
            English commands are fine; this exists to find where the real limit is.

    config DICT_MIN_PROB_PCT
        int "Confidence floor, percent"
        range 0 100
        default 20
        help
            Deliberately low. On a probe build we want to see what the engine produces,
            not a filtered view of it. Every result is logged regardless; this only
            gates what reaches the screen.

    config DICT_VAD_ENERGY_DBFS
        int "VAD energy floor, dBFS"
        range -80 -20
        default -48
        help
            Below this the neural VAD will not call it speech. 02 measured a quiet room
            producing detections at 0.135 with VAD reporting no speech; this floor is
            what removed them.

    config DICT_VAD_TAIL_MS
        int "Silence before an utterance is considered finished, ms"
        range 200 3000
        default 700

    config DICT_BRIGHTNESS
        int "Screen brightness, percent"
        range 5 100
        default 85

    config DICT_NTP
        bool "Set the clock from NTP in maintenance mode"
        default y

    config DICT_LONG_PRESS_MS
        int "Hold BOOT this long for maintenance mode, ms"
        range 300 5000
        default 1200

    config DICT_MIC_GAIN_DB
        int "Microphone gain (dB)"
        range 0 42
        default 30
        help
            ES8311 input PGA gain. At 30 dB an adult at arm's length peaks around
            -12 dBFS with the room at -52 dBFS (2026-09-06). A soft-spoken child may
            need 33-36; clipping shows as peaks at 0 dBFS in the "mic:" lines.

    config DICT_VOLUME
        int "Speaker volume (0-100)"
        range 0 100
        default 90
        help
            The vendor example uses 90 on V2 hardware and 70 on V1.

    config DICT_TZ
        string "Time zone (POSIX TZ string)"
        default "AEST-10AEDT,M10.1.0,M4.1.0/3"
        help
            Used for timestamps in the log file. Default is Sydney.

    config DICT_WIFI_SSID
        string "Home Wi-Fi network for NTP"
        depends on DICT_NTP
        default ""

    config DICT_WIFI_PASSWORD
        string "Home Wi-Fi password"
        depends on DICT_NTP
        default ""

    config DICT_NTP_SERVER
        string "NTP server"
        depends on DICT_NTP
        default "pool.ntp.org"

    config DICT_NTP_TIMEOUT_S
        int "Seconds to wait for Wi-Fi before giving up"
        depends on DICT_NTP
        range 3 60
        default 15

    config DICT_LOG_MAX_KB
        int "Log file cap (KB) before rotation to .1"
        range 64 65536
        default 4096

    config DICT_POWER_LOG_S
        int "Seconds between power records"
        range 5 3600
        default 30

    config DICT_MAINT_IDLE_MIN
        int "Minutes without a request before maintenance mode ends"
        range 1 120
        default 10

    config DICT_THERMAL_WARM_C
        int "Thermal guard: warm, die C (screen dims)"
        range 30 120
        default 60
        help
            The hotter of the chip die and the PMU die, read once a second. At warm the
            screen is held at the dim level and the status line says so. Die
            temperatures run well above the case; calibrate against a thermometer on
            the glass before trusting the defaults for a child's hands.

    config DICT_THERMAL_HOT_C
        int "Thermal guard: hot, die C (sleep, charger off, BOOT ignored)"
        range 30 125
        default 70

    config DICT_THERMAL_TRIP_C
        int "Thermal guard: trip, die C (PMU powers the board off)"
        range 30 130
        default 80
        help
            The board writes a marker to NVS, records the trip on the card, waits
            three seconds for the card, and powers itself off through the PMU. It comes
            back on PWR or a USB insert, and the boot record names the trip.

    config DICT_THERMAL_HYST_C
        int "Thermal guard: degrees below a line before the level drops"
        range 1 20
        default 5

    config DICT_THERMAL_SAMPLES
        int "Thermal guard: consecutive seconds that must agree before the level changes"
        range 1 60
        default 5

    config DICT_PMU_TREG_C
        int "PMU charger thermal regulation, die C (60, 80, 100 or 120)"
        range 60 120
        default 60
        help
            The AXP2101 lowers its own charge current once its die passes this line,
            whether or not the firmware is running. Chip default 100. Values between
            the four steps round down.


endmenu
```
